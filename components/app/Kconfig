## components/app/Kconfig
```kconfig
menu "Deye HMI"

    config DEYE_SCREENSHOT_HTTP
        bool "Enable LAN screenshots and display diagnostics on HTTP port 80"
        default y
        select LV_USE_SNAPSHOT
        help
            Exposes the active monitoring screen as /screenshot.bmp, plus
            /health and /metrics. Use only on a trusted LAN. Protected screens
            and dialogs cannot be captured.

    config DEYE_DEFAULT_BACKEND_HOST
        string "Default backend host (empty = configure on device)"
        default ""
        help
            Optional development default. Leave empty for release builds so no
            network settings are hard-coded. Set it in sdkconfig.local, which is
            not committed.

    config DEYE_DEFAULT_BACKEND_PORT
        int "Default backend port"
        default 9101
        range 1 65535

    config DEYE_OTA_ALLOW_HTTP
        bool "Allow firmware updates over plain HTTP (insecure)"
        default n
        select ESP_HTTPS_OTA_ALLOW_HTTP
        help
            Development only. When disabled, OTA URLs must use HTTPS and the
            server certificate is verified against the bundled CA store.

    config DEYE_TELEMETRY_MAX_BYTES
        int "Maximum accepted /metrics payload size"
        default 65536
        range 8192 262144

endmenu
```

## sdkconfig.defaults
```kconfig
# Target: Waveshare ESP32-S3-Touch-LCD-7B (ESP32-S3-WROOM-1-N16R8)
CONFIG_IDF_TARGET="esp32s3"
CONFIG_ESPTOOLPY_FLASHSIZE_16MB=y
CONFIG_ESPTOOLPY_FLASHMODE_QIO=y
CONFIG_PARTITION_TABLE_CUSTOM=y
CONFIG_PARTITION_TABLE_CUSTOM_FILENAME="partitions.csv"

# CPU / caches / PSRAM (values from the official Waveshare LVGL 9 example)
CONFIG_ESP_DEFAULT_CPU_FREQ_MHZ_240=y
CONFIG_FREERTOS_HZ=1000
CONFIG_SPIRAM=y
CONFIG_SPIRAM_MODE_OCT=y
CONFIG_SPIRAM_SPEED_80M=y
CONFIG_SPIRAM_XIP_FROM_PSRAM=y
CONFIG_SPIRAM_MEMTEST=n
CONFIG_SPIRAM_USE_MALLOC=y
CONFIG_SPIRAM_MALLOC_ALWAYSINTERNAL=4096
CONFIG_SPIRAM_MALLOC_RESERVE_INTERNAL=65536
CONFIG_ESP32S3_INSTRUCTION_CACHE_32KB=y
CONFIG_ESP32S3_DATA_CACHE_64KB=y
CONFIG_ESP32S3_DATA_CACHE_LINE_64B=y

# Keep RGB DMA running from PSRAM while flash is written (NVS / OTA)
CONFIG_LCD_RGB_ISR_IRAM_SAFE=y

# OTA with rollback
CONFIG_BOOTLOADER_APP_ROLLBACK_ENABLE=y
CONFIG_ESP_HTTPS_OTA_DECRYPT_CB=n

# Watchdogs
CONFIG_ESP_TASK_WDT_EN=y
CONFIG_ESP_TASK_WDT_TIMEOUT_S=10
CONFIG_ESP_TASK_WDT_PANIC=y

# TLS: keep handshake buffers in PSRAM; RGB display leaves little internal RAM.
CONFIG_MBEDTLS_CERTIFICATE_BUNDLE=y
CONFIG_MBEDTLS_EXTERNAL_MEM_ALLOC=y

# Logging
CONFIG_LOG_DEFAULT_LEVEL_INFO=y

# LVGL 9
CONFIG_LV_OS_FREERTOS=y
CONFIG_LV_USE_CLIB_MALLOC=y
CONFIG_LV_USE_CLIB_STRING=y
CONFIG_LV_USE_CLIB_SPRINTF=y
CONFIG_LV_DEF_REFR_PERIOD=15
CONFIG_LV_OBJ_STYLE_CACHE=y
CONFIG_LV_DRAW_SW_DRAW_UNIT_CNT=2
CONFIG_LV_COLOR_DEPTH_16=y
CONFIG_LV_FONT_MONTSERRAT_14=y
CONFIG_LV_FONT_MONTSERRAT_16=y
CONFIG_LV_FONT_MONTSERRAT_20=y
CONFIG_LV_FONT_MONTSERRAT_24=y
CONFIG_LV_FONT_MONTSERRAT_28=y
CONFIG_LV_FONT_MONTSERRAT_36=y
CONFIG_LV_FONT_MONTSERRAT_48=y
CONFIG_LV_FONT_DEFAULT_MONTSERRAT_16=y
CONFIG_LV_USE_LOG=y
CONFIG_LV_LOG_LEVEL_WARN=y
CONFIG_LV_LOG_PRINTF=y
CONFIG_LV_USE_SYSMON=n
```
